## config/boards/shields/kir/Kconfig.shield
```kconfig
config SHIELD_KIR_L
    def_bool $(shields_list_contains, kir_l)

config SHIELD_KIR_R
    def_bool $(shields_list_contains, kir_r)
```

## config/boards/shields/kir_board/Kconfig.defconfig
```kconfig
if SHIELD_KIR_BOARD_LEFT

    config ZMK_KEYBOARD_NAME
        default "Kir Board"

    config ZMK_SPLIT_BLE_ROLE_CENTRAL
        default y
endif

if SHIELD_KIR_BOARD_RIGHT

    config ZMK_KEYBOARD_NAME
        default "Kir Board Right"
endif

if SHIELD_KIR_BOARD_LEFT || SHIELD_KIR_BOARD_RIGHT

    config ZMK_SPLIT
        default y
endif
```

## config/boards/shields/kir_board/Kconfig.shield
```kconfig
config SHIELD_KIR_BOARD_LEFT
    def_bool $(shields_list_contains, kir_board_left)

config SHIELD_KIR_BOARD_RIGHT
    def_bool $(shields_list_contains, kir_board_right)
```
