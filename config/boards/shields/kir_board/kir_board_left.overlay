
#include "kir_board.dtsi" // Notice that the main dtsi files are included in the overlay.

&kscan0 {
    col-gpios
        = <&gpio1 6  GPIO_ACTIVE_HIGH> // col0 in the schematic
        , <&gpio0 10 GPIO_ACTIVE_HIGH> // col1 in the schematic
        , <&gpio0 9  GPIO_ACTIVE_HIGH> // col2 in the schematic
        , <&gpio0 24 GPIO_ACTIVE_HIGH> // col3 in the schematic
        , <&gpio0 13 GPIO_ACTIVE_HIGH> // col4 in the schematic
        , <&gpio0 20 GPIO_ACTIVE_HIGH> // col5 in the schematic
        , <&gpio0 17 GPIO_ACTIVE_HIGH> // col6 in the schematic
        ;
};